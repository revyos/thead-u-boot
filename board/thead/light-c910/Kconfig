## board/thead/light-c910/Kconfig
```kconfig
#
# Copyright (C) 2017-2020 Alibaba Group Holding Limited
#
# SPDX-License-Identifier: GPL-2.0+
#

if TARGET_LIGHT_C910

config PMIC_VOL_INIT
    bool "tuning light-ddr regulators"
    default n

config DDR_REGU_0V6
    int "uint in uv"
    default 600000

config DDR_REGU_0V8
    int "uint in uv"
    default 800000

config DDR_REGU_1V1
    int "uint in uv"
    default 1100000

config SYS_CPU
    default "c9xx"

config SYS_VENDOR
    default "thead"

config SYS_BOARD
    default "light-c910"

config SYS_CONFIG_NAME
    default "light-c910"

config LIGHT_BOOT_FORCE_SEQ
	bool "light boot force sequence"
	default n

config LIGHT_SEC_UPGRADE
    bool "light secure upgrade"
    default n

config LIGHT_ANDROID_BOOT_IMAGE_VAL_A
    bool "light board-a android image"
    default n

config AVB_USE_OEM_KEY
    bool "AVB signature with OEM key"
    default n

config AVB_ROLLBACK_ENABLE
    bool "AVB rollback index in RPMB"
    default n

config AVB_HW_ENGINE_ENABLE
    bool "AVB Hardware cryptographic engine enable"
    default n

config LIGHT_ANDROID_BOOT_IMAGE_VAL_B
    bool "light board-b android image"
    default n

config LIGHT_ANDROID_BOOT_IMAGE_VAL_LPI4A
    bool "light board-lpi4a android image"
    default n

config LIGHT_SEC_BOOT_WITH_VERIFY_VAL_A
    bool "light board-a security boot with verification"
    default n

config LIGHT_SEC_BOOT_WITH_VERIFY_VAL_B
    bool "light board-b security boot with verification"
    default n

config LIGHT_SEC_BOOT_WITH_VERIFY_ANT_REF
    bool "light ant ref security boot with verification"
    default n

config LIGHT_SEC_BOOT_WITH_VERIFY_LPI4A
    bool "light lpi4a security boot with verification"
    default n

config TARGET_LIGHT_FPGA_FM_C910
    bool "light fullmask FPGA board"
    default n

config TARGET_LIGHT_FM_C910_VAL_SV
    bool "light fullmask VAL board for system validation"
    default n

config TARGET_LIGHT_FM_C910_VAL_A
    bool "light fullmask VAL board-a for system validation"
    default n

config TARGET_LIGHT_FM_C910_A_REF
    bool "light fullmask reference A board"
    default n

config TARGET_LIGHT_FM_C910_VAL_B
    bool "light fullmask VAL board-b for system validation"
    default n

config TARGET_LIGHT_FM_C910_B_REF
    bool "light fullmask reference B board"
    default n

config TARGET_LIGHT_FM_C910_VAL_ANT_REF
    bool "light fullmask for ant-ref board "
    default n

config TARGET_LIGHT_FM_C910_VAL_ANT_DISCRETE
    bool "light fullmask for ant-discrete board "
    default n

config TARGET_LIGHT_FM_C910_BEAGLE
    bool "light fullmask for beagle board "
    default n

config TARGET_LIGHT_FM_C910_LPI4A
    bool "light fullmask for Lichee Pi 4A board "
    default n

config TARGET_LIGHT_FM_C910_B_POWER
    bool "light fullmask for light-b-power board "
    default n

config SYS_TEXT_BASE
    default 0xc0000000 if RISCV_MMODE
    default 0x00200000 if RISCV_SMODE

config SPL_TEXT_BASE
    hex
    default 0xffe0000800 if LIGHT_SEC_BOOT_WITH_VERIFY_VAL_A || LIGHT_SEC_BOOT_WITH_VERIFY_VAL_B || LIGHT_SEC_BOOT_WITH_VERIFY_ANT_REF || LIGHT_SEC_BOOT_WITH_VERIFY_LPI4A
    default 0xffe0000000 if !(LIGHT_SEC_BOOT_WITH_VERIFY_VAL_A || LIGHT_SEC_BOOT_WITH_VERIFY_VAL_B || LIGHT_SEC_BOOT_WITH_VERIFY_ANT_REF || LIGHT_SEC_BOOT_WITH_VERIFY_LPI4A)

config SPL_MAX_SIZE
    hex
    default 0x2f000

config THEAD_PLIC
	bool "Light PLIC Setting"
	depends on RISCV_MMODE || SPL_RISCV_MMODE
	select REGMAP
	select SYSCON
	default n
	help
	  The Thead PLIC block holds memory-mapped claim and pending registers
	  associated with software interrupt.

config THEAD_LIGHT_TIMER
	bool "Light TIMER0 driver and test"
	depends on THEAD_PLIC
	default n
	help
	  The timer driver to verify the plic interrupt framework is ready

config THEAD_LIGHT_DIGITAL_SENSOR
	bool "Light Digital Sensor Setting"
	depends on THEAD_PLIC
	default n
	help
	  The security digital sensor driver

config BOARD_SPECIFIC_OPTIONS
    def_bool y
    select RISCV_THEAD
    imply CMD_NET
    imply CMD_PING
    imply CMD_MEMINFO
    imply MII
    imply NET_RANDOM_ETHADDR
    imply PHY_LIB
    imply PHY_MSCC
    imply MMC
    imply MMC_SPI
    imply MMC_BROKEN_CD
    imply CMD_MMC

if !TARGET_LIGHT_FPGA_FM_C910
config DDR_LP4X_4266_DUALRANK
        bool "LPDDR4X 4266 dualrank configuration"
        help
          Enabling this will support lpddr4x 4266 dualrank configuration.
config DDR_LP4X_4266_SINGLERANK
        bool "LPDDR4X 4266 singlerank configuration"
        help
          Enabling this will support lpddr4x 4266 singlerank configuration.
config DDR_LP4X_3733_DUALRANK
        bool "LPDDR4X 3733 dualrank configuration"
        help
          Enabling this will support lpddr4x 3733 dualrank configuration.
config DDR_LP4X_3733_SINGLERANK
        bool "LPDDR4X 3733 singlerank configuration"
        help
          Enabling this will support lpddr4x 3733 singlerank configuration.
config DDR_LP4X_3200_DUALRANK
        bool "LPDDR4X 3200 dualrank configuration"
        help
          Enabling this will support lpddr4x 3200 dualrank configuration.
config DDR_LP4X_3200_SINGLERANK
        bool "LPDDR4X 3200 singlerank configuration"
        help
          Enabling this will support lpddr4x 3200 singlerank configuration.
config DDR_LP4X_2133_DUALRANK
        bool "LPDDR4X 2133 dualrank configuration"
        help
          Enabling this will support lpddr4x 2133 dualrank configuration.
config DDR_LP4X_2133_SINGLERANK
        bool "LPDDR4X 2133 singlerank configuration"
        help
          Enabling this will support lpddr4x 2133 singlerank configuration.
config DDR_LP4_4266_DUALRANK
        bool "LPDDR4 4266 dualrank configuration"
        help
          Enabling this will support lpddr4 4266 dualrank configuration.
config DDR_LP4_4266_SINGLERANK
        bool "LPDDR4 4266 singlerank configuration"
        help
          Enabling this will support lpddr4 4266 singlerank configuration.
config DDR_LP4_3733_DUALRANK
        bool "LPDDR4 3733 dualrank configuration"
        help
          Enabling this will support lpddr4 3733 dualrank configuration.
config DDR_LP4_3733_SINGLERANK
        bool "LPDDR4 3733 singlerank configuration"
        help
          Enabling this will support lpddr4 3733 singlerank configuration.
config DDR_LP4_3200_DUALRANK
        bool "LPDDR4 3200 dualrank configuration"
        help
          Enabling this will support lpddr4 3200 dualrank configuration.
config DDR_LP4_3200_SINGLERANK
        bool "LPDDR4 3200 singlerank configuration"
        help
          Enabling this will support lpddr4 3200 singlerank configuration.
config DDR_LP4_2133_DUALRANK
        bool "LPDDR4 2133 dualrank configuration"
        help
          Enabling this will support lpddr4 2133 dualrank configuration.
config DDR_LP4_2133_SINGLERANK
        bool "LPDDR4 2133 singlerank configuration"
        help
          Enabling this will support lpddr4 2133 singlerank configuration.

config DDR_H32_MODE
        bool "LPDDR4/4X 32bit mode configuration"
        help
          Enabling this will support ddr 32bit mode configuration.

config LPDDR4X
        def_bool y if DDR_LP4X_4266_DUALRANK || DDR_LP4X_4266_SINGLERANK || DDR_LP4X_3733_DUALRANK || DDR_LP4X_3733_SINGLERANK \
                        || DDR_LP4X_3200_DUALRANK || DDR_LP4X_3200_SINGLERANK || DDR_LP4X_2133_DUALRANK || DDR_LP4X_2133_SINGLERANK
config LPDDR4
        def_bool y if !LPDDR4X && (DDR_LP4_4266_DUALRANK || DDR_LP4_4266_SINGLERANK || DDR_LP4_3733_DUALRANK || DDR_LP4_3733_SINGLERANK \
                        || DDR_LP4_3200_DUALRANK || DDR_LP4_3200_SINGLERANK || DDR_LP4_2133_DUALRANK || DDR_LP4_2133_SINGLERANK)

config LPDDR
        def_bool y if LPDDR4X || LPDDR4

config DDR_4266
        def_bool y if DDR_LP4X_4266_DUALRANK || DDR_LP4X_4266_SINGLERANK || DDR_LP4_4266_DUALRANK || DDR_LP4_4266_SINGLERANK
config DDR_3733
        def_bool y if DDR_LP4X_3733_DUALRANK || DDR_LP4X_3733_SINGLERANK || DDR_LP4_3733_DUALRANK || DDR_LP4_3733_SINGLERANK
config DDR_3200
        def_bool y if DDR_LP4X_3200_DUALRANK || DDR_LP4X_3200_SINGLERANK || DDR_LP4_3200_DUALRANK || DDR_LP4_3200_SINGLERANK
config DDR_2133
        def_bool y if DDR_LP4X_2133_DUALRANK || DDR_LP4X_2133_SINGLERANK || DDR_LP4_2133_DUALRANK || DDR_LP4_2133_SINGLERANK

config FW_MSG_L3
        def_bool n
config FW_MSG_L2
        def_bool n if !FW_MSG_L3
config FW_MSG_L1
        def_bool n if !FW_MSG_L3 && !FW_MSG_L2
config FW_MSG_TRAIN_1D
        def_bool n if FW_MSG_L2
config DDR_MSG
	def_bool y if FW_MSG_L1 || FW_MSG_L2 || FW_MSG_L3
config DDR_HARD_2D
	def_bool n

config DDR_DUAL_RANK
	def_bool y if DDR_LP4X_4266_DUALRANK || DDR_LP4X_3733_DUALRANK || DDR_LP4X_3200_DUALRANK || DDR_LP4X_2133_DUALRANK \
			|| DDR_LP4_4266_DUALRANK || DDR_LP4_3733_DUALRANK || DDR_LP4_3200_DUALRANK || DDR_LP4_2133_DUALRANK

config DDR_CHBIT_256B
        def_bool y if !DDR_H32_MODE

config DDR_DBI_OFF
        def_bool n

config LPDDR_EYE
        def_bool n
config LPDDR_TXEYE
        def_bool n if LPDDR_EYE
endif

endif
```

## configs/light_lpi4a_android_defconfig
```kconfig
CONFIG_RISCV=y
CONFIG_SPL_MMC_SUPPORT=y
CONFIG_ENV_SIZE=0x20000
CONFIG_ENV_OFFSET=0xe0000
CONFIG_NR_DRAM_BANKS=8
CONFIG_SPL=y
CONFIG_SMP=y
CONFIG_TARGET_LIGHT_C910=y
CONFIG_TARGET_LIGHT_FM_C910_LPI4A=y
CONFIG_ARCH_RV64I=y
CONFIG_DISTRO_DEFAULTS=y
CONFIG_BUILD_TARGET="u-boot-with-spl.bin"
CONFIG_DISPLAY_CPUINFO=y
CONFIG_DISPLAY_BOARDINFO=y
# CONFIG_SPL_LEGACY_IMAGE_SUPPORT is not set
CONFIG_SPL_RAM_SUPPORT=y
CONFIG_SPL_RAM_DEVICE=y
CONFIG_SYS_PROMPT="C910 Light# "
CONFIG_DDR_LP4X_3733_DUALRANK=y
# CONFIG_DDR_LP4_3733_DUALRANK is not set
CONFIG_DDR_BOARD_CONFIG=y
CONFIG_CMD_BOOT_SLAVE=y
CONFIG_CMD_ERASEENV=y
CONFIG_CMD_GPT=y
CONFIG_CMD_MTD=y
CONFIG_CMD_EXT4_WRITE=y
CONFIG_CMD_SPI=y
CONFIG_CMD_I2C=y
CONFIG_CMD_MEMTEST=y
CONFIG_DDR_SCAN=y
CONFIG_DDR_PRBS_TEST=n
# CONFIG_DOS_PARTITION is not set
# CONFIG_ISO_PARTITION is not set
CONFIG_PARTITION_TYPE_GUID=y
CONFIG_OF_EMBED=y
CONFIG_DEFAULT_DEVICE_TREE="light-lpi4a"
CONFIG_ENV_IS_IN_MMC=y
CONFIG_SYS_RELOC_GD_ENV_ADDR=y
CONFIG_SPL_CLK=y
CONFIG_USB_FUNCTION_FASTBOOT=y
CONFIG_UDP_FUNCTION_FASTBOOT=y
CONFIG_FASTBOOT_BUF_ADDR=0x10000000
CONFIG_FASTBOOT_FLASH=y
CONFIG_FASTBOOT_FLASH_MMC_DEV=0
CONFIG_FASTBOOT_CMD_OEM_FORMAT=y
CONFIG_DM_GPIO=y
CONFIG_DM_I2C=y
CONFIG_SYS_I2C_DW=y
CONFIG_DWAPB_GPIO=y
# CONFIG_MMC_SPI is not set
CONFIG_MMC_VERBOSE=y
CONFIG_SUPPORT_EMMC_BOOT=y
CONFIG_MMC_IO_VOLTAGE=y
CONFIG_MMC_UHS_SUPPORT=y
CONFIG_MMC_HS400_SUPPORT=y
CONFIG_MMC_DW=y
CONFIG_MMC_DW_SNPS=y
CONFIG_MMC_SDHCI=y
CONFIG_MMC_SDHCI_SNPS=y
CONFIG_MMC_SDHCI_SDMA=y
CONFIG_CMD_MMC=y
CONFIG_CMD_MMC_RPMB=y
CONFIG_SUPPORT_EMMC_RPMB=y
CONFIG_DM_MTD=y
CONFIG_MTD_SPI_NAND=y
CONFIG_SPI_FLASH_WINBOND=y
CONFIG_ETH_DESIGNWARE=y
CONFIG_PHY_REALTEK=y
CONFIG_RTL8211E_PINE64_GIGABIT_FIX=y
CONFIG_RTL8211X_PHY_FORCE_MASTER=y
CONFIG_RTL8211F_PHY_FORCE_EEE_RXC_ON=y
CONFIG_SYS_NS16550=y
CONFIG_SPI=y
CONFIG_DESIGNWARE_SPI=y
CONFIG_DESIGNWARE_QSPI=y
CONFIG_USB=y
CONFIG_USB_DWC3=y
CONFIG_USB_GADGET=y
CONFIG_USB_GADGET_MANUFACTURER="U-Boot-THEAD"
CONFIG_USB_GADGET_VENDOR_NUM=0x1234
CONFIG_USB_GADGET_PRODUCT_NUM=0x8888
# CONFIG_SPL_USE_TINY_PRINTF is not set
# CONFIG_EFI_LOADER is not set
# CONFIG_LIGHT_SEC_BOOT is not set
CONFIG_BOARD_LATE_INIT=y
CONFIG_ENV_VARS_UBOOT_RUNTIME_CONFIG=y
CONFIG_DM_VIDEO=y
CONFIG_PHY=y
CONFIG_REGMAP=y
CONFIG_SYSCON=y
CONFIG_CMD_BMP=y
CONFIG_VIDEO_BRIDGE=y
CONFIG_DM_PCA953X=y
CONFIG_VIDEO_VS_DPU=y
CONFIG_VIDEO_LCD_ILITEK_ILI9881C=y
CONFIG_VIDEO_DW_DSI_LIGHT=y
CONFIG_VIDEO_DW_DPHY=y
CONFIG_VIDEO_DW_DSI_HOST=y
CONFIG_SYS_WHITE_ON_BLACK=y
CONFIG_PMIC_VOL_INIT=y
CONFIG_DDR_REGU_0V6=600000
CONFIG_DDR_REGU_0V8=800000
CONFIG_DDR_REGU_1V1=1100000
CONFIG_ANDROID_BOOT_IMAGE=y
CONFIG_LIBAVB=y
CONFIG_AVB_VERIFY=y
CONFIG_CMD_AVB=y
CONFIG_CMD_BOOTANDROID=y
CONFIG_ANDROID_AB=y
CONFIG_CMD_AB_SELECT=y
CONFIG_XBC=y
```
