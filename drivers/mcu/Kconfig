## drivers/mcu/Kconfig
```kconfig
menu "MCU Support"

config DM_MCU
	bool "Enable driver model for mcu device support"
	depends on DM
	help
	  This adds a simple uclass for mcu device.
	  
config MCU_HC32fX
	bool "Enable HC32fX MCU support"
	depends on DM_MCU
	help
	  This adds a driver for the HC32fX MCU support.

endmenu
```

## drivers/power/fuel_gauge/Kconfig
```kconfig
config DM_FUEL_GAUGE
	bool "Enable driver model fuel gauge support"
	depends on DM
	help
	  This adds a simple uclass for fuel gauge.

config POWER_FG_CW201X
	bool "CW201X Fuel gauge support"
	depends on DM_FUEL_GAUGE
	help
	  This adds support for CW201X fuel gauge support.
```
